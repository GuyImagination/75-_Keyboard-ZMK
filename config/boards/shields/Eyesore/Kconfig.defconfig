## config/boards/shields/Eyesore/Kconfig.defconfig
```kconfig
if SHIELD_EYESORE

config ZMK_KEYBOARD_NAME
    default "Eyesore"

config SPI
    default y

endif
```

## config/west.yml
```yaml
manifest:
  defaults:
    revision: v0.3
  remotes:
    - name: zmkfirmware
      url-base: https://github.com/zmkfirmware
    - name: uebari # One popular 595 implementation
      url-base: https://github.com/uebari
  projects:
    - name: zmk
      remote: zmkfirmware
      revision: main
      import: app/west.yml
    - name: zmk-595 # The missing link
      remote: uebari
      revision: main
  self:
    path: config
```
